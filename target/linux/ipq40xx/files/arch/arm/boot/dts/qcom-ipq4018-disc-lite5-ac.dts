// SPDX-License-Identifier: GPL-2.0-or-later OR MIT
/* Copyright (c) 2020, Robert Marko <robimarko@gmail.com> */

#include "qcom-ipq4018-lhg-dk.dtsi"

/ {
	model = "MikroTik DISC Lite5 ac (RBDiscG-5acD)";
	compatible = "mikrotik,disc-lite5-ac";
};

&wifi1 {
	status = "okay";

	qcom,ath10k-calibration-variant = "MikroTik-DISC-Lite5-ac";
};
