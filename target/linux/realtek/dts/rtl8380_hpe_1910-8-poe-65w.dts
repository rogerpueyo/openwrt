// SPDX-License-Identifier: GPL-2.0-or-later OR MIT

#include "rtl8380_hpe_1920-8g.dtsi"

/ {
	compatible = "hpe,1910-8-poe-65w", "realtek,rtl838x-soc";
	model = "HPE 1910-8-PoE+ 65W (JG537A)";
};

&uart1 {
	status = "okay";
};
